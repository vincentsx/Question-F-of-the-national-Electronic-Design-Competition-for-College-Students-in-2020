#include "Filter.h"
#include "msp430f5529_i2c.h"
#include "LMT70.h"
/*-------------------------------------------------------------------------------
*  本部分主要为滤波算法
*  相关数据的滤波处理请添加再末尾                         
--------------------------------------------------------------------------------*/

/*******************************************************************************
*  函数名称：Bubbl                           
*  功能说明：冒泡排序
*  参数说明：float a[]   ：数据数组
*           int n 		：数组元素数量
*  函数返回：无
*  使用示例：无
********************************************************************************/
void Bubbl(float a[],int n)//冒泡排序
{
    int i,j;
    float temp1;
    for(i=0;i<n-1;i++)			//n-1
    {
        for(j=0;j<n-i-1;j++)	//n-i-1
        {
            if(a[j]>a[j+1])		//大于就交换
            {
                temp1 = a[j];
                a[j] = a[j+1];
                a[j+1] = temp1;
            }
        }
    }
}

/*******************************************************************************
*  函数名称：Filter                           
*  功能说明：对数据进行滤波
*  参数说明：float a[]   ：数据数组
*           int n 		：数组元素数量
*  函数返回：av_value
*  使用示例：Filter(Mlx90614_Temp,10);
********************************************************************************/
float Filter(float a[],int n)
{
	int i = 0;
	float data_sum1 = 0;
	float av_value = 0;
	Bubbl(a,n);			//排序
	for(i=0;i<n-1;i++)  		//去除最大最小值
	{
		a[i] = a[i+1];
	}	 
	for(i = 0;i < (n-2);i++)	//均值滤波
	{
		data_sum1 = data_sum1 + a[i];
 
	}
	av_value = data_sum1 / (n-2);
	
	return av_value;
}

/*******************************************************************************
*  函数名称：Mlx90614_Filter                           
*  功能说明：得到Mlx90614滤波后的温度值
*  参数说明：无
*  函数返回：温度
*  使用示例：无
********************************************************************************/
float Mlx90614_Filter()
{
	int i;
	float Mlx90614_Temp[10] = {0};
	for(i = 0; i < 10; i++)
	{
		Mlx90614_Temp[i] = MemoryRead(I2C0) / 50.0 -273.15;
	}
	return Filter(Mlx90614_Temp,10);
}

/*******************************************************************************
*  函数名称：Lmt70_Filter                           
*  功能说明：得到Lmt70滤波后的温度值
*  参数说明：无
*  函数返回：温度
*  使用示例：无
********************************************************************************/
float Lmt70_Filter()
{
	int i;
	float Lmt70_Temp[10] = {0};
	for(i = 0; i < 10; i++)
	{
		Lmt70_Temp[i] = Temp_3();
	}
	return Filter(Lmt70_Temp,10);
}